/*
Uno:
RGB:   TX0/#1
HSync: OCR0B/#5
VSync: OCR1B/#10

Mega:
RGB:   TX0/#1
HSync: OCR0B
VSync: OCR1B/#10

Leonardo:
RGB:   TX1/#1
HSync: OCR0B/PD0/SCL
VSync: OCR1B/#10

Teensy20pp:
RGB:   TX1/PD3
HSync: OCR0B
VSync: OCR1A/PB5
*/

#include "pgmspees.h"
#include "sleepy.h"
#include "board.h"
#include "misc.h"
#include <avr/io.h>

static const uint8_t screen_font[8][256] PROGMEM = 
{
  { 
  0xFF, 0xC0, 0xC0, 0xC9, 0xF7, 0xE3, 0xF7, 0xFF, 0x80, 0xFF, 0x80, 0xF8, 0xE1, 0xE0, 0xC0, 0xB3, 
  0xBF, 0xFE, 0xF3, 0xCC, 0xC0, 0xE0, 0xFF, 0xF3, 0xF3, 0xF3, 0xFF, 0xFF, 0xFF, 0xFF, 0xFF, 0xFF, 
  0xFF, 0xE7, 0xC9, 0xC9, 0xE7, 0xFF, 0xE3, 0xCF, 0xF3, 0xCF, 0xFF, 0xFF, 0xFF, 0xFF, 0xFF, 0xFC, 
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  0xFF, 0xE7, 0xCF, 0xF3, 0xF8, 0xF3, 0xE7, 0xFF, 0xE3, 0xFF, 0xFF, 0xF8, 0xC3, 0xC7, 0xFF, 0xFF, 
  }, 
  { 
  0xFF, 0xBF, 0x80, 0x80, 0xE3, 0xC1, 0xF7, 0xFF, 0x80, 0xE1, 0x9E, 0xFC, 0xCC, 0xE6, 0xCE, 0xD2, 
  0x8F, 0xF8, 0xE1, 0xCC, 0x92, 0xCE, 0xFF, 0xE1, 0xE1, 0xF3, 0xF3, 0xE7, 0xFF, 0xED, 0xF3, 0x80, 
  0xFF, 0xC3, 0xC9, 0xC9, 0xC1, 0x9C, 0xC9, 0xCF, 0xE7, 0xE7, 0xCC, 0xE7, 0xFF, 0xFF, 0xFF, 0xF9, 
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  0x81, 0xE7, 0xE7, 0xE7, 0xF2, 0xF3, 0xE7, 0xC4, 0xC9, 0xFF, 0xFF, 0xF9, 0xC9, 0xF3, 0xFF, 0xFF, 
  }, 
  { 
  0xFF, 0xAD, 0x92, 0x80, 0xC1, 0xE3, 0xE3, 0xF3, 0x8C, 0xCC, 0xB3, 0xF8, 0xCC, 0xE0, 0xC0, 0xE1, 
  0x83, 0xE0, 0xC0, 0xCC, 0x92, 0xE3, 0xFF, 0xC0, 0xC0, 0xF3, 0xF9, 0xCF, 0x9F, 0xCC, 0xE1, 0x80, 
  0xFF, 0xC3, 0xC9, 0x80, 0x9F, 0x99, 0xE3, 0x9F, 0xCF, 0xF3, 0xE1, 0xE7, 0xFF, 0xFF, 0xFF, 0xF3, 
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  0xFF, 0x81, 0xF3, 0xCF, 0xF2, 0xF3, 0xFF, 0x91, 0xC9, 0xFF, 0xFF, 0xF9, 0xC9, 0xE7, 0xE1, 0xFF, 
  }, 
  { 
  0xFF, 0xBF, 0x80, 0x80, 0x80, 0x80, 0xC1, 0xE1, 0x9E, 0xDE, 0xA1, 0xC1, 0xCC, 0xE7, 0xCE, 0x8C, 
  0x80, 0x80, 0xF3, 0xCC, 0xC2, 0xC9, 0xFF, 0xF3, 0xF3, 0xF3, 0x80, 0x80, 0x9F, 0x80, 0xC0, 0xC0, 
  0xFF, 0xE7, 0xFF, 0xC9, 0xC3, 0xF3, 0xC4, 0xFF, 0xCF, 0xF3, 0x80, 0x81, 0xFF, 0x81, 0xFF, 0xE7, 
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  0x81, 0xE7, 0xE7, 0xE7, 0xF3, 0xF3, 0x81, 0xFF, 0xE3, 0xF3, 0xFF, 0xF9, 0xC9, 0xCF, 0xE1, 0xFF, 
  }, 
  { 
  0xFF, 0xA1, 0x9E, 0xC1, 0xC1, 0x80, 0x80, 0xE1, 0x9E, 0xDE, 0xA1, 0x99, 0xE1, 0xE7, 0xCE, 0x8C, 
  0x83, 0xE0, 0xF3, 0xCC, 0xF2, 0xC9, 0xC0, 0xC0, 0xF3, 0xC0, 0xF9, 0xCF, 0x9F, 0xCC, 0x80, 0xE1, 
  0xFF, 0xE7, 0xFF, 0x80, 0xF9, 0xE7, 0x91, 0xFF, 0xCF, 0xF3, 0xE1, 0xE7, 0xFF, 0xFF, 0xFF, 0xCF, 
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  0xFF, 0xE7, 0xCF, 0xF3, 0xF3, 0xF3, 0xFF, 0xC4, 0xFF, 0xF3, 0xF3, 0x89, 0xC9, 0xC3, 0xE1, 0xFF, 
  }, 
  { 
  0xFF, 0xB3, 0x8C, 0xE3, 0xE3, 0xC1, 0xC1, 0xF3, 0x8C, 0xCC, 0xB3, 0x99, 0xF3, 0xC7, 0xCC, 0xE1, 
  0x8F, 0xF8, 0xC0, 0xFF, 0xF2, 0xE3, 0xC0, 0xE1, 0xF3, 0xE1, 0xF3, 0xE7, 0x80, 0xED, 0x80, 0xF3, 
  0xFF, 0xFF, 0xFF, 0xC9, 0x83, 0xCC, 0x99, 0xFF, 0xE7, 0xE7, 0xCC, 0xE7, 0xE7, 0xFF, 0xE7, 0x9F, 
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  0x81, 0xFF, 0xFF, 0xFF, 0xF3, 0x93, 0xE7, 0x91, 0xFF, 0xFF, 0xFF, 0xC9, 0xFF, 0xFF, 0xE1, 0xFF, 
  }, 
  { 
  0xFF, 0xBF, 0x80, 0xF7, 0xF7, 0xE3, 0xE3, 0xFF, 0x80, 0xE1, 0x9E, 0x99, 0xC0, 0x87, 0x8C, 0xD2, 
  0xBF, 0xFE, 0xE1, 0xCC, 0xF2, 0x99, 0xC0, 0xF3, 0xF3, 0xF3, 0xFF, 0xFF, 0xFF, 0xFF, 0xFF, 0xFF, 
  0xFF, 0xE7, 0xFF, 0xC9, 0xE7, 0x9C, 0xC4, 0xFF, 0xF3, 0xCF, 0xFF, 0xFF, 0xE7, 0xFF, 0xE7, 0xBF, 
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  0xFF, 0x81, 0x81, 0x81, 0xF3, 0x93, 0xE7, 0xFF, 0xFF, 0xFF, 0xFF, 0xE1, 0xFF, 0xFF, 0xFF, 0xFF, 
  }, 
  { 
  0xFF, 0xC0, 0xC0, 0xFF, 0xFF, 0xC1, 0xC1, 0xFF, 0x80, 0xFF, 0x80, 0xC3, 0xF3, 0x8F, 0x9F, 0xB3, 
  0xFF, 0xFF, 0xF3, 0xFF, 0xFF, 0xC3, 0xFF, 0x80, 0xFF, 0xFF, 0xFF, 0xFF, 0xFF, 0xFF, 0xFF, 0xFF, 
  0xFF, 0xFF, 0xFF, 0xFF, 0xFF, 0xFF, 0xFF, 0xFF, 0xFF, 0xFF, 0xFF, 0xFF, 0xCF, 0xFF, 0xFF, 0xFF, 
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  0xFF, 0xFF, 0xFF, 0xFF, 0xF3, 0xC7, 0xFF, 0xFF, 0xFF, 0xFF, 0xFF, 0xF1, 0xFF, 0xFF, 0xFF, 0xFF, 
  }, 
};

class Display
{
public:
    Display();
    void scanLine();
    void interrupt();
    char message[1][20];
private:
    volatile int messageLine;
    volatile int vLine;
    volatile uint8_t backPorchLinesToGo;
};

Display display;

Display::Display()
{
    for (int i = 0; i < 30; i++)
        my_strcpy(message[0], "Line xxx - hello!");

    zei();
    *p_ocr1b_ddr |= 1<<ocr1b_bit;
    *p_tccr1a = 1<<wgm10 | 1<<wgm11 | 1<<com1b1;  
    *p_tccr1b = 1<<wgm12 | 1<<wgm13 | 5;
    *p_ocr1a = 259;
    *p_ocr1b = 0;
#if defined (__AVR_ATmega8__)
    *p_tifr = 1<<tov1;
    *p_timsk = 1<<toie1;
#else
    *p_tifr1 = 1<<tov1;
    *p_timsk1 = 1<<toie1;
#endif
    *p_ocr0b_ddr |= 1<<ocr0b_bit;
    *p_tccr0a = 1<<wgm00 | 1<<wgm01 | 1<<com0b1;
    *p_tccr0b = 1<<wgm02 | 2;
    *p_ocr0a = 63;
    *p_ocr0b = 7;
#if defined (__AVR_ATmega8__)
    *p_tifr = 1<<tov0;
    *p_timsk = 1<<toie0;
#else
    *p_tifr0 = 1<<tov0;
    *p_timsk0 = 1<<toie0;
#endif
    *p_ubrr9 = 0;
    *p_ucsr9b = 0; 
    *p_ucsr9c = 1<<umsel90 | 1<<umsel91 | 1<<ucpol9; // 1<<ucpha0?
    set_sleep_mode(SLEEP_MODE_IDLE);
}

void Display::interrupt()
{
    vLine = 0;
    messageLine = 0;
    backPorchLinesToGo = 35;
}

void Display::scanLine()
{    
    if (backPorchLinesToGo)
    {
        backPorchLinesToGo--;
        return;   
    }
    
    if (vLine >= 480)
        return;
    
    const register uint8_t *linePtr = &screen_font[vLine>>1 & 0x07][0];
    char *messagePtr = &(message[messageLine][0]);
    uint8_t i = 20;
    *p_ucsr9b = 1<<txen9;

    while (i--)
        *p_udr9 = pgm_read_byte(linePtr + *messagePtr++);

    while ((*p_ucsr9a & 1<<txc9) == 0)
        ;
  
    *p_ucsr9b = 0;
    vLine++;  
#if 0
    if ((vLine & 0xF) == 0)
        messageLine++;
#endif
}

int main()
{
    while (true)
    {
        sleep_mode();
        display.scanLine();
    }

    return 0;
}

extern "C" void TIMER0_OVF __attribute__ ((signal, used, externally_visible));
void TIMER0_OVF
{
}

extern "C" void TIMER1_OVF __attribute__ ((signal, used, externally_visible));
void TIMER1_OVF
{
    display.interrupt();
}


